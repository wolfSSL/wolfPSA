## zephyr/tests/psa_concurrency/testcase.yaml
```yaml
# Copyright (C) 2026 wolfSSL Inc.
# SPDX-License-Identifier: GPL-3.0-or-later
common:
  filter: not CONFIG_BUILD_WITH_TFM
  tags:
    - wolfpsa
    - psa
tests:
  crypto.wolfpsa.psa_concurrency:
    integration_platforms:
      - native_sim/native/64
```

## zephyr/tests/psa_consumer/testcase.yaml
```yaml
# Copyright (C) 2026 wolfSSL Inc.
# SPDX-License-Identifier: GPL-3.0-or-later
#
# Runs Zephyr's provider-agnostic PSA crypto ztest against the wolfPSA custom
# provider (instead of Mbed TLS), proving wolfPSA is a drop-in PSA provider.
common:
  filter: not CONFIG_BUILD_WITH_TFM
  harness: ztest
  tags:
    - wolfpsa
    - psa
tests:
  crypto.wolfpsa.psa_consumer:
    integration_platforms:
      - native_sim/native/64
  # Single-threaded variant: exercises the CONFIG_WOLFPSA_THREAD_SAFE=n baseline
  # path (SINGLE_THREADED, no-op lock macros) so it is not left untested.
  crypto.wolfpsa.psa_consumer.single_threaded:
    extra_configs:
      - CONFIG_WOLFPSA_THREAD_SAFE=n
    integration_platforms:
      - native_sim/native/64
```

## zephyr/tests/psa_its/testcase.yaml
```yaml
# Copyright (C) 2026 wolfSSL Inc.
# SPDX-License-Identifier: GPL-3.0-or-later
common:
  filter: not CONFIG_BUILD_WITH_TFM
  tags:
    - wolfpsa
    - psa
    - secure_storage
  harness: console
  harness_config:
    type: one_line
    regex:
      - "Sample finished successfully."
tests:
  crypto.wolfpsa.psa_its:
    integration_platforms:
      - native_sim/native/64
```

## zephyr/tests/psa_persistent_key/testcase.yaml
```yaml
# Copyright (C) 2026 wolfSSL Inc.
# SPDX-License-Identifier: GPL-3.0-or-later
#
# Runs Zephyr's own persistent-key PSA sample against wolfPSA (drop-in proof).
common:
  filter: not CONFIG_BUILD_WITH_TFM
  tags:
    - wolfpsa
    - psa
    - secure_storage
  harness: console
  harness_config:
    type: one_line
    regex:
      - "Sample finished successfully."
tests:
  crypto.wolfpsa.psa_persistent_key:
    integration_platforms:
      - native_sim/native/64
```

## zephyr/tests/psa_purge/testcase.yaml
```yaml
# Copyright (C) 2026 wolfSSL Inc.
# SPDX-License-Identifier: GPL-3.0-or-later
#
# Direct coverage for psa_purge_key(): a live key purges to PSA_SUCCESS, and an
# absent key is rejected with PSA_ERROR_INVALID_HANDLE -- the latter path is not
# driven by any other wolfPSA test (all existing callers purge a key that
# exists).
common:
  filter: not CONFIG_BUILD_WITH_TFM
  tags:
    - wolfpsa
    - psa
tests:
  crypto.wolfpsa.psa_purge:
    integration_platforms:
      - native_sim/native/64
```

## zephyr/tests/psa_secure_storage/testcase.yaml
```yaml
# Copyright (C) 2026 wolfSSL Inc.
# SPDX-License-Identifier: GPL-3.0-or-later
common:
  filter: not CONFIG_BUILD_WITH_TFM
  tags:
    - wolfpsa
    - psa
    - secure_storage
tests:
  crypto.wolfpsa.psa_secure_storage:
    integration_platforms:
      - native_sim/native/64
```

## zephyr/tests/psa_store_unavailable/testcase.yaml
```yaml
# Copyright (C) 2026 wolfSSL Inc.
# SPDX-License-Identifier: GPL-3.0-or-later
#
# Pins the documented degradation contract of wolfPSA's Zephyr store backend
# when CONFIG_SECURE_STORAGE is unset: volatile keys keep working, and a
# persistent-key operation fails cleanly (a storage error, no crash) instead of
# silently succeeding. Complements psa_its / psa_persistent_key / psa_secure_storage,
# which all build the CONFIG_SECURE_STORAGE branch.
common:
  filter: not CONFIG_BUILD_WITH_TFM
  tags:
    - wolfpsa
    - psa
    - secure_storage
tests:
  crypto.wolfpsa.psa_store_unavailable:
    integration_platforms:
      - native_sim/native/64
```

## zephyr/tests/psa_tls_coexist/testcase.yaml
```yaml
# Copyright (C) 2026 wolfSSL Inc.
# SPDX-License-Identifier: GPL-3.0-or-later
common:
  tags:
    - wolfpsa
    - psa
    - tls
  harness: ztest
tests:
  crypto.wolfpsa.tls_coexist:
    integration_platforms:
      - native_sim/native/64
```

## zephyr/tests/psa_transform/testcase.yaml
```yaml
# Copyright (C) 2026 wolfSSL Inc.
# SPDX-License-Identifier: GPL-3.0-or-later
#
# Unit-tests wolfPSA's wolfCrypt AES-GCM secure_storage ITS transform directly:
# confidentiality at rest, tamper detection, and UID binding -- behavior Zephyr's
# own passthrough custom-transform test cannot cover. The generic persistent-key
# / ITS flows are covered by the psa_its, psa_persistent_key and
# psa_secure_storage wrappers (which run Zephyr's own apps against wolfPSA).
common:
  filter: not CONFIG_BUILD_WITH_TFM
  tags:
    - wolfpsa
    - psa
    - secure_storage
tests:
  crypto.wolfpsa.psa_transform:
    integration_platforms:
      - native_sim/native/64
```
